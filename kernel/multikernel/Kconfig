## kernel/multikernel/Kconfig
```kconfig
# SPDX-License-Identifier: GPL-2.0-only
#
# Multikernel configuration
#

config MULTIKERNEL
	bool "Multikernel support"
	depends on KEXEC_CORE
	depends on KEXEC_HANDOVER
	select LIBFDT
	select GENERIC_ALLOCATOR
	help
	  Enable multikernel support, which allows running multiple kernel
	  instances simultaneously with resource isolation and inter-kernel
	  communication capabilities.

	  This feature provides:
	  - Sysfs interface for multikernel instance management
	  - Device tree based resource specification
	  - Memory pool management for kernel instances
	  - Integration with kexec for kernel loading
	  - KHO (Kexec HandOver) support for seamless DTB transfer

	  Requires KEXEC_HANDOVER for preserving device trees and instance
	  state across kernel boundaries.
	  RISC-V support requires the SBI HSM and IPI extensions. The current
	  CPU resource representation also requires hart IDs to fit within
	  NR_CPUS; sparse or larger hart IDs are not yet supported.

	  If unsure, say N.
```
